## components/fitimage/Milk-V-Jupiter/Milk-V-Jupiter.its
```
/*
 * SPDX-License-Identifier: BSD-2-Clause
 *
 * Copyright (c) 2025, Spacemit Ltd.
 *
 *  description for flattened image tree file.
 */

/dts-v1/;

/ {
    description = "EDK2 FIT image for k1 Milk-V-Jupiter";
    #address-cells = <2>;
    fit,fdt-list = "of-list";

    images {
        uefi {
            description = "EDK2";
            type = "standalone";
            os = "U-BOOT";
            arch = "riscv";
            compression = "none";
            load = <0x0 0x00200000>;
            data = /incbin/("./MILK-V-JUPITER.fd");
        };

        fdt_1 {
            description = "k1-Milk-V-Jupiter";
            type = "flat_dt";
            compression = "none";
            data = /incbin/("./Milk-V-Jupiter.dtb");
            hash-1 {
                algo = "crc32";
            };
        };
    };

    configurations {
        default = "conf_1";
        conf_1 {
            description = "k1-Milk-V-Jupiter";
            loadables = "uefi";
            fdt = "fdt_1";
        };
    };
};
```
